## Config.in
```kconfig
#

mainmenu "Buildroot $BR2_VERSION Configuration"

menu "System features"
	
config MBEDTLS_HAVE_ASM
	bool "Assembly code support"
	default y
	help
	  Compiler support for asm().

config MBEDTLS_NO_UDBL_DIVISION
	bool "Lack of double-width integer division"
	default n
	help
	  Support for double-width integer division (64-bit division on a
	  32-bit platform, 128-bit division on a 64-bit platform).

config MBEDTLS_HAVE_SSE2
	bool "SSE2 instruction set support"
	default n
	help
	  CPU supports SSE2 (IA-32 specific).
	  
config MBEDTLS_HAVE_TIME
	bool "Time features available"
	default y
	help
	  System has time.h and time().
	  The time does not need to be correct, only time differences are used,
	  by contrast with MBEDTLS_HAVE_TIME_DATE.

config MBEDTLS_HAVE_TIME_DATE
	bool "Date features available"
	depends on MBEDTLS_HAVE_TIME
	default y
	help
	  System has time.h and time(), gmtime() and the clock is correct.
	  The time needs to be correct (not necesarily very accurate, but at least
	  the date should be correct). This is used to verify the validity period of
	  X.509 certificates.

config MBEDTLS_PLATFORM_C
	bool "Platform abstraction layer"
	default y
	help
	  Enable the platform abstraction layer that allows you to re-assign
	  functions like calloc(), free(), snprintf(), printf(), fprintf(), exit().

	  Enabling MBEDTLS_PLATFORM_C enables to use of MBEDTLS_PLATFORM_XXX_ALT
	  or MBEDTLS_PLATFORM_XXX_MACRO directives, allowing the functions mentioned
	  above to be specified at runtime or compile time respectively.

	  This abstraction layer must be enabled on Windows (including MSYS2)
	  as other module rely on it for a fixed snprintf implementation.


config MBEDTLS_PLATFORM_MEMORY
	bool "Custom memory allocation"
	depends on MBEDTLS_PLATFORM_C
	default n
	help
	  By default mbed TLS uses the system-provided calloc() and free().
	  This allows different allocators (self-implemented or provided) to be
	  provided to the platform abstraction layer.
	  
	  Enabling MBEDTLS_PLATFORM_MEMORY without the
	  MBEDTLS_PLATFORM_{FREE,CALLOC}_MACROs will provide
	  "mbedtls_platform_set_calloc_free()" allowing you to set an alternative
	  calloc() and free() function pointer at runtime.

	  Enabling MBEDTLS_PLATFORM_MEMORY and specifying
	  MBEDTLS_PLATFORM_{CALLOC,FREE}_MACROs will allow you to specify the
	  alternate function at compile time.

config MBEDTLS_PLATFORM_NO_STD_FUNCTIONS
	bool "No standard functions"
	depends on MBEDTLS_PLATFORM_C
	default n
	help
	  Do not assign standard functions in the platform layer (e.g. calloc() to
	  MBEDTLS_PLATFORM_STD_CALLOC and printf() to MBEDTLS_PLATFORM_STD_PRINTF)

	  This makes sure there are no linking errors on platforms that do not 
	  support these functions. You will HAVE to provide alternatives, either
	  at runtime via the platform_set_xxx() functions or at compile time by 
	  setting the MBEDTLS_PLATFORM_STD_XXX defines, or enabling a
	  MBEDTLS_PLATFORM_XXX_MACRO.

menu "Alternative platform macros"
	depends on MBEDTLS_PLATFORM_C

config MBEDTLS_PLATFORM_EXIT_ALT
	string "exit macro"
	default ""

config MBEDTLS_PLATFORM_TIME_ALT
	string "time macro"
	depends on MBEDTLS_HAVE_TIME
	default ""

config MBEDTLS_PLATFORM_FPRINTF_ALT
	string "fprintf macro"
	default ""

config MBEDTLS_PLATFORM_PRINTF_ALT
	string "printf macro"
	default ""

config MBEDTLS_PLATFORM_SNPRINTF_ALT
	string "snprintf macro"
	default ""

config MBEDTLS_PLATFORM_NV_SEED_ALT
	string "nv_seed macro"
	default ""

config MBEDTLS_PLATFORM_SETUP_TEARDOWN_ALT
	string "setup_teardown macro"
	default ""	
endmenu

config MBEDTLS_DEPRECATED_WARNING
	bool "Deprecated warnings"
	default n
	help
	  Mark deprecated functions so that they generate a warning if used.
	  Functions deprecated in one version will usually be removed in the next
	  version. You can enable this to help you prepare the transition to a new
	  major version by making sure your code is not using these functions.
	  
	  This only works with GCC and Clang. With other compilers, you may want to
	  use MBEDTLS_DEPRECATED_REMOVED

config MBEDTLS_DEPRECATED_REMOVED
	bool "Deprecated errors"
	default n
	help
	  Remove deprecated functions so that they generate an error if used.
	  Functions deprecated in one version will usually be removed in the next
	  version. You can enable this to help you prepare the transition to a new
	  major version by making sure your code is not using these functions.
	  
endmenu

menu "mbed TLS features"

endmenu
```
